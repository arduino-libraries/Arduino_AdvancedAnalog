// This example outputs a sine wave on A12/DAC0.

#include "AdvancedDAC.h"
uint16_t lut[] = {
    0x0800,0x0832,0x0864,0x0896,0x08c8,0x08fa,0x092c,0x095e,0x098f,0x09c0,0x09f1,0x0a22,0x0a52,0x0a82,0x0ab1,0x0ae0,
    0x0b0f,0x0b3d,0x0b6b,0x0b98,0x0bc5,0x0bf1,0x0c1c,0x0c47,0x0c71,0x0c9a,0x0cc3,0x0ceb,0x0d12,0x0d39,0x0d5f,0x0d83,
    0x0da7,0x0dca,0x0ded,0x0e0e,0x0e2e,0x0e4e,0x0e6c,0x0e8a,0x0ea6,0x0ec1,0x0edc,0x0ef5,0x0f0d,0x0f24,0x0f3a,0x0f4f,
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    0x04f0,0x051f,0x054e,0x057d,0x05ad,0x05dd,0x060e,0x063f,0x0670,0x06a1,0x06d3,0x0705,0x0737,0x0769,0x079b,0x07cd
};

AdvancedDAC dac_1(A12);
static size_t lut_offs = 0;
static size_t lut_size = sizeof(lut) / sizeof(lut[0]);

void setup() {
    Serial.begin(9600);

    while (!Serial) {

    }

    if (!dac_1.begin(DAC_RESOLUTION_12, 8000, 64, 16)) {
        Serial.println("Failed to start DAC1 !");
        while (1);
    }
}

void dac_output_sq(AdvancedDAC &dac_out) {
    if (dac_out.available()) {
        // Get a free buffer for writing.
        SampleBuffer buf = dac_out.dequeue();

        // Write data to buffer.
        for (size_t i=0; i<buf.size(); i++, lut_offs++) {
            buf[i] =  lut[lut_offs % lut_size];
        }

        // Writethe buffer to DAC.
        dac_out.write(buf);
    }
}

void loop() {
    dac_output_sq(dac_1);
}
